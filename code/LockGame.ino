//Created by Cleary Bettisworth

#include <U8g2lib.h> 

int buzzerPin = 7;
int stickX = A0;
int stickY = A1;
int pinSpotX = random(50,950);
int pinSpotY = random(50,950);
int offsetX = -5  + random(-2, 1);
int offsetY = random(-2, 1);
int buttonPin = 2;
int buttonState = 0;
int pinsPicked = 0;
bool pickStatus[3] = {true, true, true};
long startTime = 0;

U8G2_SSD1306_128X64_NONAME_F_HW_I2C oled{U8G2_R0};

//Lock graphics
#define Lock_width 50
#define Lock_height 50
const static unsigned char Lock_bits[] PROGMEM = {
   0x00, 0x00, 0x00, 0x00, 0x00, 0x00, 0x00, 0x00, 0x00, 0x00, 0x00, 0x00,
   0x00, 0x00, 0x00, 0x00, 0xc0, 0x1f, 0x00, 0x00, 0x00, 0x00, 0x00, 0xf0,
   0x3f, 0x00, 0x00, 0x00, 0x00, 0x00, 0xf0, 0x3f, 0x00, 0x00, 0x00, 0x00,
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   0x00, 0x00 };

//Pointer graphics
#define pointer_width 5
#define pointer_height 5
const static unsigned char pointer_bits[] PROGMEM = {
   0x00, 0x0a, 0x04, 0x0a, 0x00 };

//Target graphics
#define target_width 15
#define target_height 15
const static unsigned char target_bits[] PROGMEM = {
   0xfc, 0x1f, 0x3e, 0x3e, 0x0f, 0x78, 0x07, 0x70, 0x03, 0x60, 0x03, 0x60,
   0x01, 0x40, 0x01, 0x40, 0x01, 0x40, 0x03, 0x60, 0x03, 0x60, 0x07, 0x70,
   0x0f, 0x78, 0x3e, 0x3e, 0xfc, 0x1f };

//Pick graphics
#define pick_width 5
#define pick_height 10
const static unsigned char pick_bits[] PROGMEM = {
   0x00, 0x08, 0x0c, 0x04, 0x04, 0x04, 0x04, 0x04, 0x04, 0x00 };

//Inital Setup
void setup() {

  oled.begin();
  oled.setFont(u8g2_font_ncenB08_tr);
  pinMode(buttonPin, INPUT_PULLUP);
  pinMode(buzzerPin,OUTPUT);
  pinMode(stickX, INPUT);
  pinMode(stickY, INPUT);
  Serial.begin(57600);
  randomSeed(analogRead(0));

}

//Main Loop
void loop() {

  oled.clearBuffer();
  oled.setCursor(0,10);
 
  //Reads joystick input
  int posX = analogRead(stickX);
  int posY = analogRead(stickY);
  int distX = abs(analogRead(stickX) - pinSpotX);
  int distY = abs(analogRead(stickY) - pinSpotY);
  int distAvg = (distY + distX ) / 2;

  checkDistance(distX, distY, distAvg);
  buttonPress(distAvg);
  checkGameState();

  //Positions pointer and target
  int pointerPosX = map(posX, 0, 1023, 55, 75);
  int pointerPosY = map(posY, 0, 1023, 10, 35);
  int targetPosX = map(pinSpotX, 50, 950, 55, 75) + offsetX;
  int targetPosY = map(pinSpotY, 50, 950, 10, 30) + offsetY;

  //Shows remaining picks
  displayPicks();

  //Checks if all picks are broken
  if(allPicksBroken()) {
    displayGameOver();
  }

  //Draws Lock, Target, and Pointer
  oled.drawXBMP(45, 0, Lock_width, Lock_height, Lock_bits);
  oled.drawXBMP(targetPosX, targetPosY, target_width, target_height, target_bits);
  oled.drawXBMP(pointerPosX, pointerPosY, pointer_width, pointer_height, pointer_bits);

  oled.sendBuffer();

}

//If Game Over state is reached, displays game over text before resetting
void displayGameOver() {

    oled.clearBuffer(); 
    oled.setCursor(0, 25);
    oled.print("Game Over");
    oled.sendBuffer(); 
    delay(10000);
    for(int i = 0; i < 3; i++) {
      pickStatus[i] = true;
    }
    startTime = millis();
    return;   

}

//Shows the current number of picks on screen
void displayPicks() {

  int currentX = 0;
  for(int i = 0; i < 3; i++) {
    if(pickStatus[i]) {
      oled.drawXBMP(currentX, 0, pick_width, pick_height, pick_bits);
      currentX += 5; 
    }
  }
}

//Compares distance between pointer and target position
void checkDistance(int distX, int distY, int distAvg) {

  if(distX <= 150 && distY <= 150) {
    digitalWrite(buzzerPin, HIGH);
    delay(distAvg / 5);
    digitalWrite(buzzerPin, LOW);
    delay(distAvg / 5);  
  }else {
    digitalWrite(buzzerPin, LOW);
  }
}

//If button is pressed, compares distance and determines if it was a succesful pick or not
void buttonPress(int distAvg) {

  buttonState = digitalRead(buttonPin);
  
  if(buttonState == HIGH) {
    if(distAvg <= 25) {
      pinSpotX = random(50,950);
      pinSpotY = random(50,950);
      pinsPicked += 1;
    }else {
      oled.print("Pick Break!" );
      for(int i = 0; i < 3; i++) {
        if(pickStatus[i]) {
          pickStatus[i] = false;
          break;
        }
      }
    }
  }
}

//Checks how many times the lock has been picked, if its 3, displays time to beat the game
void checkGameState() {

  if(pinsPicked == 3) {

    long endTime = millis();
    long totalTime = endTime - startTime;
    oled.clearBuffer(); 
    oled.setCursor(0, 25);
    oled.print("Lock Picked in: ");
    oled.print(totalTime/1000);
    oled.print(" s");
    oled.sendBuffer(); 
    delay(10000);
    for(int i = 0; i < 3; i++) {
      pickStatus[i] = true;
    }
    pinsPicked = 0;
    startTime = millis();
    return;
  }
}

//Checks if there are picks left to play with
bool allPicksBroken() {

  for(int i = 0; i < 3; i++) {
    if(pickStatus[i]) {
      return false; 
    }
  }
  return true; 

}
